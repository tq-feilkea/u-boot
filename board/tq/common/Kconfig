## board/tq/common/Kconfig
```kconfig
# SPDX-License-Identifier: GPL-2.0-or-later
#
# Copyright (c) 2023-2026 TQ-Systems GmbH <u-boot@ew.tq-group.com>,
# D-82229 Seefeld, Germany.
# Author: Markus Niebel, Max Merchel
#

config TQ_COMMON_BB
	bool
	default y

config TQ_COMMON_SDMMC
	bool

config TQ_COMMON_SOM
	bool

config TQ_COMMON_SPL_BOARD_SETUP
	bool
	depends on SPL

config TQ_COMMON_SYSINFO
	bool
	select SYSINFO
	imply SYSINFO_TQ_EEPROM

if TQ_COMMON_SYSINFO

config TQ_COMMON_SYSINFO_MACADDR_OFFSET
	int "TQ EEPROM MAC address offset"
	default 1
	help
	  Set ethXaddr variables based on EEPROM contents
	  starting with this offset

config TQ_COMMON_SYSINFO_MACADDR_NUM
	int "TQ EEPROM MAC address number"
	default 1
	help
	  Number of ethXaddr variables to set
	  based on EEPROM contents

endif
```
